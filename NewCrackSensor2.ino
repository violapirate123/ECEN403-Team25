#include "arduinoFFT.h" //performs conversion on ADC values directly.

#define Sampling_Frequency 32000 //needs to be twice the number of the maximum frequency expected to detect.
#include <ExtendedADCShield.h>
arduinoFFT FFT = arduinoFFT(); //performs FFT from ADC data collected from microphone.
ExtendedADCShield extendedADCShield(12);

unsigned int samplingprd; //period of sampling for microprocessor.
unsigned long microsec; //unit used for sampling time.

int CrackSensor = A0; // assigns crack sensor circuit to analog pin 1.
int SecondCrack = 4; // assigns output signal for first crack to digital pin 3.
bool secondcrackregistered = false; // boolean that is set to true once the coffee roasting process is in the "First crack stage".
int crackcount = 0; //integer value to count for number of crack sounds.
int sensorval = 0;  //initialization of sensor variable, equivalent to ema Y, used for high pass filter.
float ema_a = 0.758546993;    //initialization of ema alpha, equivalent to a frequency value of around 1000hz.
int ema_S = 0;        //initialization of ema S, used for high pass filter.
int lowpassfilter = 0; //initialized to zero.

int sensorval2 = 0;
float ema_b = 0.7260813406;
int ema_T = 0;
int filteredsignal = 0;

double imaginary[128];//turns all imaginary inputs into useful data for forier transform.
double data[128];//collects real data into an array of numbers.
int i = 0;// variable used for illeteration in for loops.
int value;// ADC value generated by microprosessor.
void setup() {
  Serial.begin(9600);
  samplingprd = round(1000000*(1/Sampling_Frequency));
  pinMode (CrackSensor, INPUT); // sets crack sensor as input.
  pinMode (SecondCrack, OUTPUT);// sets firstcrack signal as output.
  ema_S = analogRead(CrackSensor); //initialize one of the variables required for lowpass filtering
  ema_T = analogRead(CrackSensor);
}

void loop() {
  sensorval = analogRead(CrackSensor);              //read the sensor value using ADC
  ema_S = (ema_a*sensorval) + ((1-ema_a)*ema_S);  //run the EMA
  lowpassfilter = ema_S; //create lowpassfilter.
  
   ema_T = (ema_b*lowpassfilter) + ((1-ema_b)*ema_T);
   filteredsignal = lowpassfilter - ema_T;
  
  

  for (i = 0;i < 128; i++){//loops 128 times to take 128 samples of ADC from electret microphone.
    microsec = micros();// sets microsec variable to the amount of time processor takes to process information.
   value = analogRead(filteredsignal);//takes sound sensor data and assigns it to premade variable "value".
   data[i] = value;// places the analog to digital values in the array "data"
   imaginary[i] = 0; //sets imaginary values to 0.
   while(micros() < (microsec + samplingprd)){//allows for a fixed sampling time depending on speed of microprocessor.
    //dont take samples while this is happening to allow processing time to catch up to sampling data.
   }
  }
  
  FFT.Windowing(data, 128, FFT_WIN_TYP_HAMMING, FFT_FORWARD);//first part of FFT 
  FFT.Compute(data, imaginary, 128, FFT_FORWARD);//computational part of FFT
  FFT.ComplexToMagnitude(data, imaginary, 128);//complex magnitude part of FFT

  
  
  double peak = FFT.MajorPeak(data, 128, Sampling_Frequency);//the peak found by the transform is set equal to "peak" variable.
 // Serial.println(peak);//this code is to test peaks
  Serial.println(" ");
  for (i = 0;i < 128; i++){
   Serial.println(data[i]);
   
  }
   for (i = 0;i < 128; i++){
  if((14300 <= data[i])&&(15600 >= data[i])){ // registers a specific frequency that is converted to a digital number and identifies the crack sound.
    crackcount = crackcount + 1; //increments value of crack sound number everytime desired frequency is detected by the microcontroller.
  }
  else{ //else statement to keep count for first crack the same.
    crackcount = crackcount; //keeps the count for firstcrack the same.
  }
  if(crackcount >= 7){ // if 7 CLEAR cracks are heard, the boolean "firstcrackregistered" is set to true.
    secondcrackregistered = true; //boolean is set to true with given condition.
  }
  
}
  if(secondcrackregistered){ //first crack is successfully registered.
  digitalWrite(SecondCrack, HIGH); // LED for first crack stays constantly on when the boolean for first crack is set to true.
  } 

  else{ // else statement when first crack boolean is set to false.
  digitalWrite(SecondCrack, LOW); //keeps the LED for first crack on while the boolean for first crack remains false.
 }
}
